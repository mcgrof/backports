## backport/compat/Kconfig
```kconfig
#
# backport Kconfig
#
# Some options are user-selectable ("BACKPORT_USERSEL_*")
#
# Most options, however, follow a few different schemes:
#
# A) An option that is selected by drivers ("select FOO") will be
#    changed to "select BACKPORT_FOO" (if the option BACKPORT_FOO
#    exists). The option BACKPORT_FOO then controls setting of the
#    BACKPORT_BUILD_FOO option, which is a module, like this:
#
# config BACKPORT_BUILD_FOO
#	tristate
#	default m if BACKPORT_FOO && !FOO
#
# config BACKPORT_FOO
#	bool
#
# This only works as-is if the kernel code is usable on any version,
# otherwise the "&& !FOO" part needs to be different.
#
#
# B) An option for code always present on some kernels (e.g. KFIFO).
#    This simply depends on/sets the default based on the version:
#
# config BACKPORT_BUILD_KFIFO
#	def_bool y
#	depends on BACKPORT_KERNEL_2_6_36
#
#
# C) similarly, a kconfig symbol for an option, e.g.
#    BACKPORT_OPTION_BT_SOCK_CREATE_NEEDS_KERN (see below)
#
#
# Variations are obviously possible.
#

config BACKPORT_BUILD_FW_LOADER
	tristate
	# RHEL6, starting from 6.0, backports the FW loader already
	depends on !BACKPORT_RHEL_KERNEL_6_0
	default m if BACKPORT_FW_LOADER && (!FW_LOADER || BACKPORT_KERNEL_2_6_33)

config BACKPORT_FW_LOADER
	bool

config BACKPORT_USERSEL_NET_SCH_CODEL
	tristate "codel"
	depends on m
	depends on !BACKPORT_KERNEL_2_6_25
	default m if NET_SCH_CODEL=n

config BACKPORT_USERSEL_NET_SCH_FQ_CODEL
	tristate "FQ codel"
	depends on m
	depends on !BACKPORT_KERNEL_2_6_25
	default m if NET_SCH_FQ_CODEL=n

config BACKPORT_BUILD_KFIFO
	def_bool y
	# RHEL6, starting from 6.1, backports kfifo already
	depends on !BACKPORT_RHEL_KERNEL_6_1
	depends on BACKPORT_KERNEL_2_6_36

config BACKPORT_BUILD_CORDIC
	tristate
	default m if BACKPORT_CORDIC && !CORDIC

config BACKPORT_CORDIC
	bool

config BACKPORT_BUILD_CRC8
	tristate
	default m if BACKPORT_CRC8 && !CRC8

config BACKPORT_CRC8
	bool

config BACKPORT_BUILD_GENERIC_ATOMIC64
	bool
	default y if !64BIT && !GENERIC_ATOMIC64

config BACKPORT_OPTION_BT_SOCK_CREATE_NEEDS_KERN
	bool
	# in RHEL6 (starting from 6.0), the function needs the argument
	default y if !BACKPORT_KERNEL_2_6_33 || BACKPORT_RHEL_KERNEL_6_0

config BACKPORT_BUILD_AVERAGE
	bool
	default y if !AVERAGE && BACKPORT_AVERAGE

config BACKPORT_AVERAGE
	bool

config BACKPORT_OPTION_USB_URB_THREAD_FIX
	bool
	default y if BACKPORT_KERNEL_2_6_36

config BACKPORT_MII
	bool



config BACKPORT_USERSEL_BUILD_ALL
	tristate "Build all compat code"
	depends on m
	select BACKPORT_USERSEL_NET_SCH_CODEL
	select BACKPORT_USERSEL_NET_SCH_FQ_CODEL
	select BACKPORT_CRC8
	select BACKPORT_CORDIC
	select BACKPORT_AVERAGE
	select BACKPORT_FW_LOADER
	help
	  This option selects all the compat code options
	  that would otherwise only be selected by drivers.

	  It's only really useful for compat testing, so
	  you probably shouldn't enable it.
```

## compat/compat/Kconfig
```kconfig
config BACKPORT_FIRMWARE_CLASS
	tristate
	default m if FIRMWARE_CLASS=m

config BACKPORT_NET_SCH_CODEL
	tristate "codel"
	depends on m
	default m if NET_SCH_CODEL=n

config BACKPORT_NET_SCH_FQ_CODEL
	tristate "FQ codel"
	depends on m
	default m if NET_SCH_FQ_CODEL=n

config BACKPORT_KFIFO
	def_bool y
	# FIXME: REDHAT_6_1 also includes this
	depends on BACKPORT_KERNEL_2_6_36

config BACKPORT_CORDIC
	bool
	default y if CORDIC=n

config BACKPORT_CRC8
	bool
	default y if !CRC8

config BACKPORT_ATOMIC64
	bool
	default y if !64BIT && !GENERIC_ATOMIC64

config BACKPORT_BT_SOCK_CREATE_NEEDS_KERN
	bool
	# FIXME: REDHAT_6_0 also requires this
	default y if !BACKPORT_KERNEL_2_6_33
```

## plumbing/Kconfig
```kconfig
mainmenu "Linux Backports from $BACKPORTED_KERNEL_NAME $BACKPORTED_KERNEL_VERSION (with backports $BACKPORTS_VERSION)"

config BACKPORTS_VERSION
	string
	option env="BACKPORTS_VERSION"
config BACKPORTED_KERNEL_VERSION
	string
	option env="BACKPORTED_KERNEL_VERSION"
config BACKPORTED_KERNEL_NAME
	string
	option env="BACKPORTED_KERNEL_NAME"

source Kconfig.kernel
source Kconfig.versions

source compat/Kconfig

source net/wireless/Kconfig
source net/mac80211/Kconfig
source drivers/net/wireless/Kconfig
source drivers/net/ethernet/Kconfig
```
